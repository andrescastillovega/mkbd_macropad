## boards/shields/mkbd_macropad/Kconfig.defconfig
```kconfig
if SHIELD_MKBD_MACROPAD_LEFT

config ZMK_KEYBOARD_NAME
    default "mkbd-macropad"

config ZMK_SPLIT_ROLE_CENTRAL
    default y

endif # SHIELD_MKBD_MACROPAD_LEFT

if SHIELD_MKBD_MACROPAD_RIGHT

config ZMK_KEYBOARD_NAME
    default "mkbd-macropad"

endif # SHIELD_MKBD_MACROPAD_RIGHT

if SHIELD_MKBD_MACROPAD_LEFT || SHIELD_MKBD_MACROPAD_RIGHT

config ZMK_SPLIT
    default y

config ZMK_BLE
    default y

config ZMK_USB
    default y

config ZMK_BATTERY_REPORTING
    default y

config ZMK_SLEEP
    default y

if ZMK_BLE

config ZMK_SPLIT_BLE
    default y

config BT_MAX_CONN
    default 2

config BT_MAX_PAIRED
    default 5

config BT_KEYS_OVERWRITE_OLDEST
    default y

endif # ZMK_BLE

if ZMK_DISPLAY

config I2C
    default y

config SSD1306
    default y

endif # ZMK_DISPLAY

if LVGL

config LV_Z_VDB_SIZE
    default 64

config LV_DPI_DEF
    default 148

config LV_Z_BITS_PER_PIXEL
    default 1

choice LV_COLOR_DEPTH
    default LV_COLOR_DEPTH_1
endchoice

config LV_USE_LABEL
    default y

endif # LVGL

endif
```

## boards/shields/mkbd_macropad/Kconfig.shield
```kconfig
config SHIELD_MKBD_MACROPAD_LEFT
    def_bool $(shields_list_contains,mkbd_macropad_left)

config SHIELD_MKBD_MACROPAD_RIGHT
    def_bool $(shields_list_contains,mkbd_macropad_right)

config ZMK_TIMER_LOGGER
    bool "Enable timer-based Hello World logging"
    default y
    help
      Enable a timer that prints "Hello World!" to console every 5 seconds.
      Useful for debugging console output functionality.

config ZMK_WIDGET_BATTERY_ANIM
    bool "Battery animation widget"
    depends on ZMK_DISPLAY
    select LV_USE_IMG
    select LV_USE_TIMER
    default y
    help
      Enable animated battery charging widget that cycles through
      battery levels when USB power is connected.
```
